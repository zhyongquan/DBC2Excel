VERSION ""

NS_ :

BS_:

BU_: ECM TCM GW

BO_ 1537 ECM_01: 8 ECM
 SG_ EngineSpeed : 7|16@0+ (0.25,0) [0|16383.8] "rpm"TCM,GW
 SG_ EngineSpeedValidity : 16|1@0+ (1,0) [0|1] ""TCM,GW

BO_ 1538 ECM_02: 8 ECM
 SG_ EngineTorque : 7|16@0- (0.01,0) [-327.68|327.67] "Nm"TCM

CM_ SG_ 1537 EngineSpeed "EngineSpeed";
CM_ SG_ 1537 EngineSpeedValidity "EngineSpeedValid";
CM_ SG_ 1538 EngineTorque "EngineTorque";

BA_DEF_ BO_  "GenMsgCycleTime" INT 0 0;
BA_DEF_ BO_  "GenMsgSendType" ENUM  "Cyclic","NotUsed","NotUsed","NotUsed","NotUsed","NotUsed","NotUsed","IfActive","NoMsgSendType","NotUsed";
BA_DEF_ SG_  "GenSigStartValue" INT 0 0;
BA_DEF_ SG_  "GenSigSendType" ENUM  "Cyclic","OnWrite","OnWriteWithRepetition","OnChange","OnChangeWithRepetition","IfActive","IfActiveWithRepetition","NoSigSendType","NotUsed","NotUsed","NotUsed","NotUsed","NotUsed";
BA_DEF_  "Baudrate" INT 0 1000000;
BA_DEF_  "BusType" STRING ;
BA_DEF_  "NmType" STRING ;
BA_DEF_  "Manufacturer" STRING ;
BA_DEF_ BU_  "NodeLayerModules" STRING ;
BA_DEF_  "NmAsrWaitBusSleepTime" INT 0 65535;
BA_DEF_  "NmAsrTimeoutTime" INT 1 65535;
BA_DEF_  "NmAsrRepeatMessageTime" INT 0 65535;
BA_DEF_ BU_  "NmAsrNodeIdentifier" HEX 0 255;
BA_DEF_  "NmAsrMessageCount" INT 1 256;
BA_DEF_ BU_  "NmAsrCanMsgReducedTime" INT 1 65535;
BA_DEF_  "NmAsrCanMsgCycleTime" INT 1 65535;
BA_DEF_  "NmAsrBaseAddress" HEX 0 2047;
BA_DEF_  "DBName" STRING ;
BA_DEF_DEF_  "GenMsgCycleTime" 0;
BA_DEF_DEF_  "GenMsgSendType" "Cyclic";
BA_DEF_DEF_  "GenSigStartValue" 0;
BA_DEF_DEF_  "GenSigSendType" "Cyclic";
BA_DEF_DEF_  "Baudrate" 500000;
BA_DEF_DEF_  "BusType" "";
BA_DEF_DEF_  "NmType" "";
BA_DEF_DEF_  "Manufacturer" "Vector";
BA_DEF_DEF_  "NodeLayerModules" " ";
BA_DEF_DEF_  "NmAsrWaitBusSleepTime" 1500;
BA_DEF_DEF_  "NmAsrTimeoutTime" 2000;
BA_DEF_DEF_  "NmAsrRepeatMessageTime" 3200;
BA_DEF_DEF_  "NmAsrNodeIdentifier" 50;
BA_DEF_DEF_  "NmAsrMessageCount" 128;
BA_DEF_DEF_  "NmAsrCanMsgReducedTime" 320;
BA_DEF_DEF_  "NmAsrCanMsgCycleTime" 640;
BA_DEF_DEF_  "NmAsrBaseAddress" 1280;
BA_DEF_DEF_  "DBName" "";
BA_ "NmType" "NmAsr";
BA_ "BusType" "CAN";
BA_ "NmAsrWaitBusSleepTime" 2000;
BA_ "DBName" "test";

BA_ "GenMsgCycleTime" BO_ 1537 10;
BA_ "GenMsgCycleTime" BO_ 1538 10;

VAL_ 1537 EngineSpeedValidity 1 "Valid" 0 "Invalid" ;
